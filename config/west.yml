## config/west.yml
```yaml
manifest:
  remotes:
#    - name: moergo-sc
#      url-base: https://github.com/moergo-sc
    - name: darknao
      url-base: https://github.com/darknao
    - name: urob
      url-base: https://github.com/urob             
    - name: dhruvinsh                                # TRI-STATE
      url-base: https://github.com/dhruvinsh
    - name: rafaelromao                              # LAYER MORPH
      url-base: https://github.com/rafaelromao             


    - name: doctormachete
      url-base: https://github.com/DoctorMachete

    - name: zzeneg # <-- new entry
      url-base: https://github.com/zzeneg
    - name: srwi # <-- required for this module
      url-base: https://github.com/srwi

      

      
  projects:
  #  - name: zmk                                      # ORIGINAL
  #    remote: moergo-sc
  #    revision: main
  #    import: app/west.yml
    - name: zmk                                       # PER-LAYER RGB
      remote: darknao
      revision: rgb-layer-24.12
      import: app/west.yml

    - name: zmk-unicode
      remote: urob
      revision: main

    - name: zmk-tri-state
      remote: dhruvinsh
      revision: main

    - name: zmk-adaptive-key
      remote: urob
      revision: v0.3 # Should match ZMK release, using v0.3 instead of main just in case it breaks later on

    - name: zmk-leader-key
      remote: urob
      revision: v0.3 # Should match ZMK release, using v0.3 instead of main just in case it breaks later on
      
    - name: zmk-listeners
      remote: doctormachete
      revision: main
      
    - name: zmk-layer-morph
      remote: rafaelromao
      revision: v0.3 # set to same as ZMK version above

    - name: zmk-behavior-force-case          # ← ADD THIS
      remote: doctormachete                    # ← 
      revision: main                          # main basic

    - name: prospector-zmk-module
      remote: doctormachete
      revision: v2.0.0 
      path: modules/prospector-zmk-module

    - name: zmk-raw-hid
      remote: zzeneg        
      revision: main
    - name: zmk-keypeek-layer-notifier # <-- this module
      remote: srwi
      revision: main

      
  self:
    path: config
```
